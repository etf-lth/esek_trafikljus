## firmware/main/Kconfig.projbuild
```kconfig
menu "Traffic Light"

    config ADMIN_USERNAME
        string "Username for admin pages"
        default "root"
        help
            The client's user name which used for basic authenticate.

    config ADMIN_PASSWORD
        string "Password for admin pages"
        default "toor"
        help
            The client's password which used for basic authenticate.

    config ENABLE_ADMIN_UNAME
        string "Username for enabling admin"
        default "root"
        help
            Username for enabling admin pages.

    config ENABLE_ADMIN_PASSWD
        string "Password for enabling admin"
        default "toor"
        help
            Password for enabling admin pages.

endmenu
```
